#include <zephyr/dt-bindings/gpio/gpio.h>

/ {
	/* Same STM32 GPIO ports/pins as the application; no slave transactions. */
	relay_bus: relay-bus {
		compatible = "zephyr,w1-gpio";
		gpios = <&gpioe 9 GPIO_ACTIVE_HIGH>;
	};
	temperature_bus: temperature-bus {
		compatible = "zephyr,w1-gpio";
		gpios = <&gpiog 1 GPIO_ACTIVE_HIGH>;
	};
};
