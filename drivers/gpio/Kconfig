## drivers/gpio/Kconfig
```kconfig
# Copyright (c) 2026 Caltech Optical Observatories
# SPDX-License-Identifier: Apache-2.0

rsource "ds2408/Kconfig"
```

## drivers/gpio/ds2408/Kconfig
```kconfig
#
# Copyright (c) 2026 Caltech Optical Observatories
#

rsource "drivers/gpio/Kconfig"
```

## drivers/gpio/ds2408/drivers/gpio/Kconfig
```kconfig
#
# Copyright (c) 2026 Caltech Optical Observatories
#

menuconfig GPIO_DS2408
	bool "Maxim DS2408 1-Wire GPIO expander"
	depends on GPIO
	depends on W1
	depends on W1_NET
	help
	  Enable support for the Maxim DS2408 8-bit 1-Wire GPIO expander.

if GPIO_DS2408

config GPIO_DS2408_INIT_PRIORITY
	int "Initialization priority for DS2408"
	default 80
	help
	  Initialization priority for the DS2408 driver.

endif # GPIO_DS2408
```

## drivers/gpio/ds2408/dts/bindings/gpio/maxim,ds2408.yaml
```yaml
# Copyright (c) 2026 Caltech Optical Observatories
# SPDX-License-Identifier: Apache-2.0

description: Maxim DS2408 8-bit 1-Wire GPIO expander

compatible: "maxim,ds2408"

include: [gpio-controller.yaml, w1-slave.yaml]

properties:
  "#gpio-cells":
    const: 2

  ngpios:
    const: 8

  family-code:
    default: 0x29

  reg:
    description: |
      Optional 64-bit ROM ID used to identify the DS2408 in multidrop
      topologies. If omitted, the driver auto-reads ROM only when the bus
      has a single slave.

gpio-cells:
  - pin
  - flags
```

## dts/bindings/gpio/maxim,ds2408.yaml
```yaml
# Copyright (c) 2026 Caltech Optical Observatories
# SPDX-License-Identifier: Apache-2.0

description: Maxim DS2408 8-bit 1-Wire GPIO expander

compatible: "maxim,ds2408"

include: [gpio-controller.yaml, w1-slave.yaml]

properties:
  "#gpio-cells":
    const: 2

  ngpios:
    const: 8

  family-code:
    default: 0x29

  reg:
    description: |
      Optional 64-bit ROM ID used to identify the DS2408 in multidrop
      topologies. If omitted, the driver auto-reads ROM only when the bus
      has a single slave.

  init-gpios:
    type: phandle-array
    description: |
      Optional DS2408 pins to configure during driver initialization. The
      GPIO flags use normal Zephyr GPIO polarity flags. The input, output-low,
      and output-high properties select the initial direction/state in the
      same logical sense as Zephyr GPIO hogs, but this property is handled by
      the DS2408 driver so a missing optional relay board does not fail global
      GPIO hog initialization.

  input:
    type: boolean
    description: |
      Configure init-gpios as inputs/released. Takes precedence over
      output-low and output-high.

  output-low:
    type: boolean
    description: |
      Configure init-gpios as outputs set to logical low/inactive. Takes
      precedence over output-high.

  output-high:
    type: boolean
    description: |
      Configure init-gpios as outputs set to logical high/active.

gpio-cells:
  - pin
  - flags
```

## lib/coo_commons/Kconfig
```kconfig
# Copyright (c) 2024 Caltech Optical Observatories
# SPDX-License-Identifier: Apache-2.0

config COO_COMMONS
	bool "COO common libraries"
	default y
	help
	  Enable COO common libraries including network utilities,
	  JSON helpers, and MQTT client.

if COO_COMMONS

config COO_NETWORK
	bool "COO network utilities"
	depends on NETWORKING
	default n
	help
	  Enable simple network bootstrap helper with DHCP/static/fallback
	  IPv4 handling and link-state monitoring.

if COO_NETWORK

config NETWORK_HELPER_DHCP_TIMEOUT_MS
	int "DHCP wait before static fallback, in milliseconds"
	default 6000
	help
	  Time the COO network helper waits for a DHCPv4 lease before applying
	  an overridable static IPv4 profile. The static/fallback profile uses
	  CONFIG_NET_CONFIG_MY_IPV4_* so there is only one configured service
	  address set. This is intentionally separate from Zephyr
	  NET_CONFIG_INIT_TIMEOUT because this helper owns app-level
	  DHCP/static/fallback selection.

endif # COO_NETWORK

config COO_JSON
	bool "COO JSON utilities"
	depends on JSON_LIBRARY
	default n
	help
	  Enable lightweight JSON helper wrappers used by command handling
	  (keyed primitive extraction and key splitting).

config COO_SCHEDULED_ACTIONS
	bool "COO scheduled action helper"
	default n
	help
	  Enable a small fixed-table wrapper around Zephyr delayable work for named
	  firmware actions. This does not create a user-programmable scheduler.

config COO_MQTT
	bool "COO MQTT client wrapper"
	depends on MQTT_LIB
	select COO_NETWORK
	default n
	help
	  Enable COO MQTT client wrapper with automatic retry,
	  subscription management, and optional TLS support.
	  Provides a simplified interface over Zephyr's MQTT library
	  with built-in connection management. Requires MQTT_LIB.

if COO_MQTT

config COO_MQTT_BROKER_HOSTNAME
	string "MQTT broker hostname"
	default "test.mosquitto.org"
	help
	  Default MQTT broker hostname for DNS resolution.

config COO_MQTT_BROKER_PORT
	string "MQTT broker port"
	default "1883"
	help
	  Default MQTT broker port (1883 for plain, 8883 for TLS).

config COO_MQTT_PAYLOAD_SIZE
	int "Maximum MQTT payload size"
	default 512
	help
	  Maximum size for MQTT message payloads. This defines the
	  size of RX and TX buffers (2x this value total).

config COO_CMD_PAYLOAD_SIZE
	int "Maximum command payload size"
	range 128 COO_MQTT_PAYLOAD_SIZE
	default 512
	help
	  Maximum size for copied command request and response payloads. Keep this
	  no larger than COO_MQTT_PAYLOAD_SIZE so MQTT responses fit the transport
	  buffers, but tune it separately because command queues store full request
	  and response objects.

module = COO_MQTT
module-str = COO MQTT client wrapper
source "subsys/logging/Kconfig.template.log_config"

choice COO_MQTT_LOG_LEVEL_CHOICE
	default COO_MQTT_LOG_LEVEL_INF
endchoice

config COO_CMD_SERIAL_GUARD
	bool "Command dispatcher serial guard"
	depends on COO_JSON
	default n
	help
	  Let the command dispatcher temporarily reject MQTT commands after local
	  serial activity. The guard is runtime-only and is not persisted.

config COO_CMD_SERIAL_GUARD_DEFAULT_SECONDS
	int "Default serial guard duration"
	depends on COO_CMD_SERIAL_GUARD
	default 30
	help
	  Default number of seconds that MQTT effect commands remain blocked after
	  serial activity. A serialguard command can change this until reboot.

config COO_CMD_REBOOT
	bool "Command dispatcher reboot command"
	depends on REBOOT
	default y
	help
	  Let the command dispatcher own a built-in reboot command, including
	  command rejection after reboot is accepted and an optional application
	  prepare callback immediately before sys_reboot().

endif # COO_MQTT

endif # COO_COMMONS
```

## tests/transport/w1_mutex/testcase.yaml
```yaml
tests:
  hispec.transport.w1_mutex:
    platform_allow: nucleo_h563zi/stm32h563xx
    integration_platforms:
      - nucleo_h563zi/stm32h563xx
    tags:
      - drivers
      - w1
    timeout: 10
```

## west.yml
```yaml
# Copyright (c) 2021 Nordic Semiconductor ASA
# SPDX-License-Identifier: Apache-2.0

manifest:
  self:
    west-commands: scripts/west-commands.yml

  remotes:
    - name: zephyrproject-rtos
      url-base: https://github.com/zephyrproject-rtos

  projects:
    - name: zephyr
      remote: zephyrproject-rtos
      revision:  e60d3379133c4315504e9113ecdcc05fbe552756  # planned update to 55303e23f59df42d3ba41f0e93ca2192240f804a
      import:
        # By using name-allowlist we can clone only the modules that are
        # strictly needed by the application.
        name-allowlist:
          - cmsis_6      # required by the ARM port for Cortex-M
          - hal_stm32    # required by the st32 nucleo board
    - name: zscilib
      remote: zephyrproject-rtos
      revision: bf1cbf1a1661521cf3f528db40d842b700ecd826  # planned update to b5668a80c02e8e0a8ca5f6debdbe1dc3e09e7f35
      path: modules/lib/zscilib
    # Out-of-tree DAC Driver for optical attenuators
    - name: dac7578
      url: https://github.com/CaltechOpticalObservatories/dac7578
      revision: cc375f8610f895c99a0f689d43fe052c6e0e7cf5
      path: modules/dac/dac7578
    # Out-of-tree DS2408 1-Wire GPIO driver (enable once repo exists)
    # - name: ds2408
    #   url: <your ds2408 repo url>
    #   revision: main
    #   path: modules/gpio/ds2408
```
